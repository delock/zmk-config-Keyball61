/ {
   macros {
      vimq: vimq {
         compatible = "zmk,behavior-macro";
         #binding-cells = <0>;
         bindings = <
            &kp COLON
            &kp Q
            &kp A
            &kp RET
         >;
      };
   };
};

/ {
   macros {
      vimw: vimw {
         compatible = "zmk,behavior-macro";
         #binding-cells = <0>;
         bindings = <
            &kp COLON
            &kp W
            &kp A
            &kp EXCL
            &kp RET
         >;
      };
   };
};
